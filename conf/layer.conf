## conf/layer.conf
```bitbake
# We have a conf and classes directory, add to BBPATH
BBPATH .= ":${LAYERDIR}"

# We have recipes-* directories, add to BBFILES
BBFILES += "${LAYERDIR}/recipes-*/*/*.bb \
            ${LAYERDIR}/recipes-*/*/*.bbappend"

BBFILE_COLLECTIONS += "meta-pcie-hip"
BBFILE_PATTERN_meta-pcie-hip = "^${LAYERDIR}/"
BBFILE_PRIORITY_meta-pcie-hip = "6"

LAYERDEPENDS_meta-pcie-hip = "core"
LAYERSERIES_COMPAT_meta-pcie-hip = "kirkstone"
```
